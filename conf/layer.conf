## conf/layer.conf
```bitbake
# We have a conf and classes directory, add to BBPATH
BBPATH .= ":${LAYERDIR}"

# We have recipes-* directories, add to BBFILES
BBFILES += "${LAYERDIR}/recipes-*/*/*.bb \
            ${LAYERDIR}/recipes-*/*/*.bbappend"

BBFILE_COLLECTIONS += "meta-rstools"
BBFILE_PATTERN_meta-rstools = "^${LAYERDIR}/"
BBFILE_PRIORITY_meta-rstools = "6"

LAYERDEPENDS_meta-rstools = "core"
LAYERSERIES_COMPAT_meta-rstools = "warrior zeus"
```
